VERSION ""

NS_ :

BS_:

BU_: ABS_ECU Wheel_Sensor_ECU Engine_ECU

BO_ 258 ABS_Status_Msg: 8 ABS_ECU
 SG_ Slip_Flag : 1|1@1+ (1,0) [0|1] "" Vector__XXX
 SG_ ABS_Active : 0|1@1+ (1,0) [0|1] "" Vector__XXX

BO_ 257 Wheel_Speed_Msg: 8 Wheel_Sensor_ECU
 SG_ Wheel_Speed : 0|8@1+ (1,0) [0|120] "km/h"  ABS_ECU

BO_ 256 EMS_Data_Msg: 8 Engine_ECU
 SG_ Gear_Position : 16|16@1+ (1,0) [0|360] "Degree"  ABS_ECU
 SG_ Engine_Speed : 0|16@1+ (1,0) [0|6000] "RPM"  ABS_ECU

BA_DEF_  "BusType" STRING ;
BA_DEF_DEF_  "BusType" "CAN";
